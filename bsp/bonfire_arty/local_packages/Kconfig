## bsp/stm32/stm32u575-st-nucleo/board/Kconfig
```kconfig
menu "Hardware Drivers Config"

config SOC_STM32U575ZI
    bool
    select SOC_SERIES_STM32U5
    select RT_USING_COMPONENTS_INIT
    select RT_USING_USER_MAIN   
    default y

menu "Onboard Peripheral Drivers"

endmenu

menu "On-chip Peripheral Drivers"

    config BSP_USING_ON_CHIP_FLASH
        bool "Enable On Chip Flash"
        select RT_USING_ON_CHIP_FLASH
        default y

    config BSP_USING_GPIO
        bool "Enable GPIO"
        select RT_USING_PIN
        default y

    menuconfig BSP_USING_UART
        bool "Enable UART"
        default y
        select RT_USING_SERIAL
        if BSP_USING_UART
            config BSP_USING_UART1
                bool "Enable UART1"
                default y

            config BSP_UART1_RX_USING_DMA
                bool "Enable UART1 RX DMA"
                depends on BSP_USING_UART1 && RT_SERIAL_USING_DMA
                default n
        endif   

    menuconfig BSP_USING_SPI
        bool "Enable SPI BUS"
        default n
        select RT_USING_SPI
        if BSP_USING_SPI
            config BSP_USING_SPI1
                bool "Enable SPI1 BUS"
                default n
           
        endif

    config BSP_SCB_ENABLE_I_CACHE
        bool "Enable I Cache"
        default y
        select RT_SCB_ENABLE_I_CACHE

    config BSP_USING_USBD
        bool "Enable USB Device Mode"
        default n        
        select RT_USING_STM_USBD 
        select RT_USING_USB_DEVICE
        select BSP_USBD_TYPE_FS
       
    
        
    





    source "../libraries/HAL_Drivers/Kconfig"
      
endmenu

menu "Board extended module Drivers"

endmenu

endmenu
```
